## conf/distro/pjrxrpi5-distro.conf
```bitbake
# Distribution definition
DISTRO = "pjrxrpi5-distro"

# Global settings
DISTRO_FEATURES:append = " systemd wifi bluetooth **usrmerge**"

# systemd forced
VIRTUAL-RUNTIME_init_manager = "systemd"
VIRTUAL-RUNTIME_initscripts = ""

# NetworkManager forced
NETWORK_MANAGER = "networkmanager"

PACKAGES_EXCLUDE += " systemd-networkd systemd-resolved"

# Image format
IMAGE_FSTYPES += " wic.bz2"
```

## conf/layer.conf
```bitbake
# Yocto layer configuration

BBPATH .= ":${LAYERDIR}"
BBFILES += "${LAYERDIR}/recipes-*/*/*.bb \
            ${LAYERDIR}/recipes-*/*/*.bbappend"

BBFILE_COLLECTIONS += "pjrxrpi5"
BBFILE_PATTERN_pjrxrpi5 = "^${LAYERDIR}/"
BBFILE_PRIORITY_pjrxrpi5 = "6"

LAYERSERIES_COMPAT_pjrxrpi5 = "kirkstone"
```
